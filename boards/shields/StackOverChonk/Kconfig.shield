## boards/shields/StackOverChonk/Kconfig.shield
```kconfig
config SHIELD_STACKOVERCHONK_LEFT
    def_bool $(shields_list_contains,StackOverChonk_left)

config SHIELD_STACKOVERCHONK_RIGHT
    def_bool $(shields_list_contains,StackOverChonk_right)
```

## config/west.yml
```yaml
manifest:
  remotes:
    - name: zmkfirmware
      url-base: https://github.com/zmkfirmware
    # Additional modules containing boards/shields/custom code can be listed here as well
    # See https://docs.zephyrproject.org/3.2.0/develop/west/manifest.html#projects
    # support nice_oled and nice_epaper
    - name: mctechnology17
      url-base: https://github.com/mctechnology17
  projects:
    - name: zmk
      remote: zmkfirmware
      revision: v0.3.0
      import: app/west.yml
    # support nice_oled and nice_epaper
    - name: zmk-nice-oled
      remote: mctechnology17
      revision: main
  self:
    path: config
```
