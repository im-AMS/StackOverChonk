#include "StackOverChonk.dtsi"
#include "StackOverChonk-pinctrl.dtsi"

&default_transform {
    col-offset = <6>;
};

&kscan0 {
       col-gpios
        = <&pro_micro 8 GPIO_ACTIVE_HIGH>
        , <&pro_micro 7 GPIO_ACTIVE_HIGH>
        , <&pro_micro 5 GPIO_ACTIVE_HIGH>
        , <&pro_micro 4 GPIO_ACTIVE_HIGH>
        , <&gpio1 1 GPIO_ACTIVE_HIGH>
        , <&gpio1 2 GPIO_ACTIVE_HIGH>
        ;
};


&i2c0 {
    compatible = "nordic,nrf-twim";
    status = "okay";
    pinctrl-0 = <&i2c0_default>;
    pinctrl-1 = <&i2c0_sleep>;
    pinctrl-names = "default", "sleep";
    clock-frequency = <I2C_BITRATE_STANDARD>;

    oled: ssd1306@3c {
        compatible = "solomon,ssd1306fb";
        reg = <0x3c>;
        width = <128>;
        height = <32>;
        segment-offset = <0>;
        page-offset = <0>;
        display-offset = <0>;
        multiplex-ratio = <31>;
        com-sequential;
        prechargep = <0x22>;
        inversion-on;
    };
};  

